## fit/fitImage.its
```
/dts-v1/;

/ {
	description = "U-Boot fitImage based on poky/5.4.79+gitAUTOINC+5d52d9eea9_9797f1a493/raspberrypi4-64";
	#address-cells = <1>;

	images {
		kernel@1 {
			description = "Linux kernel";
			data = /incbin/("artifact.bin");
			type = "image";
			arch = "arm64";
			os = "linux";
			compression = "gzip";
			load = <0x8080000>;
			entry = <0x8080000>;

			hash@1 {
				algo = "sha256";
			};

			signature@1 {
				algo ="sha256,rsa4096";
				key-name-hint ="uboot_sign_key";
			};
		};

		ramdisk@1 {
			description = "ramdisk";
			data = /incbin/("artifact.bin");
			type = "ramdisk";
			arch = "arm";
			os = "linux";
			compression = "none";
			load = <0x00000000>;
			entry = <0x00000000>;

			hash@1 {
				algo = "sha256";
			};

			signature@1 {
				algo ="sha256,rsa4096";
				key-name-hint ="uboot_sign_key";
			};
		};
	};

	configurations {
		default = "conf@1";
		conf@1 {
			description = "config";
			kernel = "kernel@1";
			ramdisk = "ramdisk@1";

			hash@1 {
				algo = "sha256";
			};

			signature@1 {
				algo ="sha256,rsa4096";
				key-name-hint ="uboot_sign_key";
			};
		};
	};
};
```
